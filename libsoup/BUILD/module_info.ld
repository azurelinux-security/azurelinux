/*

    This file is automatically generated by generate-package-note.py tool.
    Do not modify this file, your changes will be lost!

*/

/*
/usr/lib/rpm/azl/generate-package-note.py --os mariner --osVersion %{distro_release_version} --type rpm --name libsoup --version 3.4.4-7.azl3 --moduleVersion 3.4.4.0 --stamp LinkerOnly --outdir /mnt/vss/_work/1/s/autosec/azurelinux/libsoup/BUILD/ 
*/

/*
{
 "moduleVersion": "3.4.4.0",
 "name": "libsoup",
 "os": "mariner",
 "osVersion": "%{distro_release_version}",
 "type": "rpm",
 "version": "3.4.4-7.azl3"
}
*/

SECTIONS
{
	.note.package (READONLY) : ALIGN(4)
	{
		BYTE(0x04) BYTE(0x00) BYTE(0x00) BYTE(0x00)
		BYTE(0x9c) BYTE(0x00) BYTE(0x00) BYTE(0x00)
		BYTE(0x7e) BYTE(0x1a) BYTE(0xfe) BYTE(0xca)
		BYTE(0x46) BYTE(0x44) BYTE(0x4f) BYTE(0x00)
		BYTE(0x7b) BYTE(0x0a) BYTE(0x20) BYTE(0x22)
		BYTE(0x6d) BYTE(0x6f) BYTE(0x64) BYTE(0x75)
		BYTE(0x6c) BYTE(0x65) BYTE(0x56) BYTE(0x65)
		BYTE(0x72) BYTE(0x73) BYTE(0x69) BYTE(0x6f)
		BYTE(0x6e) BYTE(0x22) BYTE(0x3a) BYTE(0x20)
		BYTE(0x22) BYTE(0x33) BYTE(0x2e) BYTE(0x34)
		BYTE(0x2e) BYTE(0x34) BYTE(0x2e) BYTE(0x30)
		BYTE(0x22) BYTE(0x2c) BYTE(0x0a) BYTE(0x20)
		BYTE(0x22) BYTE(0x6e) BYTE(0x61) BYTE(0x6d)
		BYTE(0x65) BYTE(0x22) BYTE(0x3a) BYTE(0x20)
		BYTE(0x22) BYTE(0x6c) BYTE(0x69) BYTE(0x62)
		BYTE(0x73) BYTE(0x6f) BYTE(0x75) BYTE(0x70)
		BYTE(0x22) BYTE(0x2c) BYTE(0x0a) BYTE(0x20)
		BYTE(0x22) BYTE(0x6f) BYTE(0x73) BYTE(0x22)
		BYTE(0x3a) BYTE(0x20) BYTE(0x22) BYTE(0x6d)
		BYTE(0x61) BYTE(0x72) BYTE(0x69) BYTE(0x6e)
		BYTE(0x65) BYTE(0x72) BYTE(0x22) BYTE(0x2c)
		BYTE(0x0a) BYTE(0x20) BYTE(0x22) BYTE(0x6f)
		BYTE(0x73) BYTE(0x56) BYTE(0x65) BYTE(0x72)
		BYTE(0x73) BYTE(0x69) BYTE(0x6f) BYTE(0x6e)
		BYTE(0x22) BYTE(0x3a) BYTE(0x20) BYTE(0x22)
		BYTE(0x25) BYTE(0x7b) BYTE(0x64) BYTE(0x69)
		BYTE(0x73) BYTE(0x74) BYTE(0x72) BYTE(0x6f)
		BYTE(0x5f) BYTE(0x72) BYTE(0x65) BYTE(0x6c)
		BYTE(0x65) BYTE(0x61) BYTE(0x73) BYTE(0x65)
		BYTE(0x5f) BYTE(0x76) BYTE(0x65) BYTE(0x72)
		BYTE(0x73) BYTE(0x69) BYTE(0x6f) BYTE(0x6e)
		BYTE(0x7d) BYTE(0x22) BYTE(0x2c) BYTE(0x0a)
		BYTE(0x20) BYTE(0x22) BYTE(0x74) BYTE(0x79)
		BYTE(0x70) BYTE(0x65) BYTE(0x22) BYTE(0x3a)
		BYTE(0x20) BYTE(0x22) BYTE(0x72) BYTE(0x70)
		BYTE(0x6d) BYTE(0x22) BYTE(0x2c) BYTE(0x0a)
		BYTE(0x20) BYTE(0x22) BYTE(0x76) BYTE(0x65)
		BYTE(0x72) BYTE(0x73) BYTE(0x69) BYTE(0x6f)
		BYTE(0x6e) BYTE(0x22) BYTE(0x3a) BYTE(0x20)
		BYTE(0x22) BYTE(0x33) BYTE(0x2e) BYTE(0x34)
		BYTE(0x2e) BYTE(0x34) BYTE(0x2d) BYTE(0x37)
		BYTE(0x2e) BYTE(0x61) BYTE(0x7a) BYTE(0x6c)
		BYTE(0x33) BYTE(0x22) BYTE(0x0a) BYTE(0x7d)
		
		KEEP (*(.note.package))
	}
}
INSERT AFTER .note.gnu.build-id;